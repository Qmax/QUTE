#ifndef INCLUDED_CYFITTERKEIL_INC
#define INCLUDED_CYFITTERKEIL_INC
$INCLUDE (cydevicekeil.inc)
$INCLUDE (cydevicekeil_trm.inc)

; I2C_1_I2C_IRQ
I2C_1_I2C_IRQ__ES2_PATCH EQU 0
I2C_1_I2C_IRQ__INTC_CLR_EN_REG EQU CYREG_INTC_CLR_EN1
I2C_1_I2C_IRQ__INTC_CLR_PD_REG EQU CYREG_INTC_CLR_PD1
I2C_1_I2C_IRQ__INTC_MASK EQU 0x80
I2C_1_I2C_IRQ__INTC_NUMBER EQU 15
I2C_1_I2C_IRQ__INTC_PRIOR_NUM EQU 7
I2C_1_I2C_IRQ__INTC_PRIOR_REG EQU CYREG_INTC_PRIOR15
I2C_1_I2C_IRQ__INTC_SET_EN_REG EQU CYREG_INTC_SET_EN1
I2C_1_I2C_IRQ__INTC_SET_PD_REG EQU CYREG_INTC_SET_PD1
I2C_1_I2C_IRQ__INTC_VECT EQU (CYREG_INTC_VECT_MBASE+0x1E)

; I2C_1_I2C_FF
I2C_1_I2C_FF__ADR EQU CYREG_I2C_ADR
I2C_1_I2C_FF__CFG EQU CYREG_I2C_CFG
I2C_1_I2C_FF__CLK_DIV1 EQU CYREG_I2C_CLK_DIV1
I2C_1_I2C_FF__CLK_DIV2 EQU CYREG_I2C_CLK_DIV2
I2C_1_I2C_FF__CSR EQU CYREG_I2C_CSR
I2C_1_I2C_FF__D EQU CYREG_I2C_D
I2C_1_I2C_FF__MCSR EQU CYREG_I2C_MCSR
I2C_1_I2C_FF__PM_ACT_CFG EQU CYREG_PM_ACT_CFG5
I2C_1_I2C_FF__PM_ACT_MSK EQU 0x04
I2C_1_I2C_FF__PM_STBY_CFG EQU CYREG_PM_STBY_CFG5
I2C_1_I2C_FF__PM_STBY_MSK EQU 0x04
I2C_1_I2C_FF__XCFG EQU CYREG_I2C_XCFG

; I2C1_SCL
I2C1_SCL__0__MASK EQU 0x01
I2C1_SCL__0__PC EQU CYREG_PRT12_PC0
I2C1_SCL__0__PORT EQU 12
I2C1_SCL__0__SHIFT EQU 0
I2C1_SCL__AG EQU CYREG_PRT12_AG
I2C1_SCL__BIE EQU CYREG_PRT12_BIE
I2C1_SCL__BIT_MASK EQU CYREG_PRT12_BIT_MASK
I2C1_SCL__BYP EQU CYREG_PRT12_BYP
I2C1_SCL__DM0 EQU CYREG_PRT12_DM0
I2C1_SCL__DM1 EQU CYREG_PRT12_DM1
I2C1_SCL__DM2 EQU CYREG_PRT12_DM2
I2C1_SCL__DR EQU CYREG_PRT12_DR
I2C1_SCL__INP_DIS EQU CYREG_PRT12_INP_DIS
I2C1_SCL__MASK EQU 0x01
I2C1_SCL__P12_0__MASK EQU 0x01
I2C1_SCL__P12_0__PC EQU CYREG_PRT12_PC0
I2C1_SCL__P12_0__PORT EQU 12
I2C1_SCL__P12_0__SHIFT EQU 0
I2C1_SCL__PORT EQU 12
I2C1_SCL__PRT EQU CYREG_PRT12_PRT
I2C1_SCL__PRTDSI__DBL_SYNC_IN EQU CYREG_PRT12_DBL_SYNC_IN
I2C1_SCL__PRTDSI__OE_SEL0 EQU CYREG_PRT12_OE_SEL0
I2C1_SCL__PRTDSI__OE_SEL1 EQU CYREG_PRT12_OE_SEL1
I2C1_SCL__PRTDSI__OUT_SEL0 EQU CYREG_PRT12_OUT_SEL0
I2C1_SCL__PRTDSI__OUT_SEL1 EQU CYREG_PRT12_OUT_SEL1
I2C1_SCL__PRTDSI__SYNC_OUT EQU CYREG_PRT12_SYNC_OUT
I2C1_SCL__PS EQU CYREG_PRT12_PS
I2C1_SCL__SHIFT EQU 0
I2C1_SCL__SIO_CFG EQU CYREG_PRT12_SIO_CFG
I2C1_SCL__SIO_DIFF EQU CYREG_PRT12_SIO_DIFF
I2C1_SCL__SIO_HYST_EN EQU CYREG_PRT12_SIO_HYST_EN
I2C1_SCL__SIO_REG_HIFREQ EQU CYREG_PRT12_SIO_REG_HIFREQ
I2C1_SCL__SLW EQU CYREG_PRT12_SLW

; I2C1_SDA
I2C1_SDA__0__MASK EQU 0x02
I2C1_SDA__0__PC EQU CYREG_PRT12_PC1
I2C1_SDA__0__PORT EQU 12
I2C1_SDA__0__SHIFT EQU 1
I2C1_SDA__AG EQU CYREG_PRT12_AG
I2C1_SDA__BIE EQU CYREG_PRT12_BIE
I2C1_SDA__BIT_MASK EQU CYREG_PRT12_BIT_MASK
I2C1_SDA__BYP EQU CYREG_PRT12_BYP
I2C1_SDA__DM0 EQU CYREG_PRT12_DM0
I2C1_SDA__DM1 EQU CYREG_PRT12_DM1
I2C1_SDA__DM2 EQU CYREG_PRT12_DM2
I2C1_SDA__DR EQU CYREG_PRT12_DR
I2C1_SDA__INP_DIS EQU CYREG_PRT12_INP_DIS
I2C1_SDA__MASK EQU 0x02
I2C1_SDA__P12_1__MASK EQU 0x02
I2C1_SDA__P12_1__PC EQU CYREG_PRT12_PC1
I2C1_SDA__P12_1__PORT EQU 12
I2C1_SDA__P12_1__SHIFT EQU 1
I2C1_SDA__PORT EQU 12
I2C1_SDA__PRT EQU CYREG_PRT12_PRT
I2C1_SDA__PRTDSI__DBL_SYNC_IN EQU CYREG_PRT12_DBL_SYNC_IN
I2C1_SDA__PRTDSI__OE_SEL0 EQU CYREG_PRT12_OE_SEL0
I2C1_SDA__PRTDSI__OE_SEL1 EQU CYREG_PRT12_OE_SEL1
I2C1_SDA__PRTDSI__OUT_SEL0 EQU CYREG_PRT12_OUT_SEL0
I2C1_SDA__PRTDSI__OUT_SEL1 EQU CYREG_PRT12_OUT_SEL1
I2C1_SDA__PRTDSI__SYNC_OUT EQU CYREG_PRT12_SYNC_OUT
I2C1_SDA__PS EQU CYREG_PRT12_PS
I2C1_SDA__SHIFT EQU 1
I2C1_SDA__SIO_CFG EQU CYREG_PRT12_SIO_CFG
I2C1_SDA__SIO_DIFF EQU CYREG_PRT12_SIO_DIFF
I2C1_SDA__SIO_HYST_EN EQU CYREG_PRT12_SIO_HYST_EN
I2C1_SDA__SIO_REG_HIFREQ EQU CYREG_PRT12_SIO_REG_HIFREQ
I2C1_SDA__SLW EQU CYREG_PRT12_SLW

; ISO_SCLK
ISO_SCLK__0__MASK EQU 0x04
ISO_SCLK__0__PC EQU CYREG_PRT3_PC2
ISO_SCLK__0__PORT EQU 3
ISO_SCLK__0__SHIFT EQU 2
ISO_SCLK__AG EQU CYREG_PRT3_AG
ISO_SCLK__AMUX EQU CYREG_PRT3_AMUX
ISO_SCLK__BIE EQU CYREG_PRT3_BIE
ISO_SCLK__BIT_MASK EQU CYREG_PRT3_BIT_MASK
ISO_SCLK__BYP EQU CYREG_PRT3_BYP
ISO_SCLK__CTL EQU CYREG_PRT3_CTL
ISO_SCLK__DM0 EQU CYREG_PRT3_DM0
ISO_SCLK__DM1 EQU CYREG_PRT3_DM1
ISO_SCLK__DM2 EQU CYREG_PRT3_DM2
ISO_SCLK__DR EQU CYREG_PRT3_DR
ISO_SCLK__INP_DIS EQU CYREG_PRT3_INP_DIS
ISO_SCLK__LCD_COM_SEG EQU CYREG_PRT3_LCD_COM_SEG
ISO_SCLK__LCD_EN EQU CYREG_PRT3_LCD_EN
ISO_SCLK__MASK EQU 0x04
ISO_SCLK__P3_2__MASK EQU 0x04
ISO_SCLK__P3_2__PC EQU CYREG_PRT3_PC2
ISO_SCLK__P3_2__PORT EQU 3
ISO_SCLK__P3_2__SHIFT EQU 2
ISO_SCLK__PORT EQU 3
ISO_SCLK__PRT EQU CYREG_PRT3_PRT
ISO_SCLK__PRTDSI__CAPS_SEL EQU CYREG_PRT3_CAPS_SEL
ISO_SCLK__PRTDSI__DBL_SYNC_IN EQU CYREG_PRT3_DBL_SYNC_IN
ISO_SCLK__PRTDSI__OE_SEL0 EQU CYREG_PRT3_OE_SEL0
ISO_SCLK__PRTDSI__OE_SEL1 EQU CYREG_PRT3_OE_SEL1
ISO_SCLK__PRTDSI__OUT_SEL0 EQU CYREG_PRT3_OUT_SEL0
ISO_SCLK__PRTDSI__OUT_SEL1 EQU CYREG_PRT3_OUT_SEL1
ISO_SCLK__PRTDSI__SYNC_OUT EQU CYREG_PRT3_SYNC_OUT
ISO_SCLK__PS EQU CYREG_PRT3_PS
ISO_SCLK__SHIFT EQU 2
ISO_SCLK__SLW EQU CYREG_PRT3_SLW

; ISO_DI0
ISO_DI0__0__MASK EQU 0x08
ISO_DI0__0__PC EQU CYREG_IO_PC_PRT15_PC3
ISO_DI0__0__PORT EQU 15
ISO_DI0__0__SHIFT EQU 3
ISO_DI0__AG EQU CYREG_PRT15_AG
ISO_DI0__AMUX EQU CYREG_PRT15_AMUX
ISO_DI0__BIE EQU CYREG_PRT15_BIE
ISO_DI0__BIT_MASK EQU CYREG_PRT15_BIT_MASK
ISO_DI0__BYP EQU CYREG_PRT15_BYP
ISO_DI0__CTL EQU CYREG_PRT15_CTL
ISO_DI0__DM0 EQU CYREG_PRT15_DM0
ISO_DI0__DM1 EQU CYREG_PRT15_DM1
ISO_DI0__DM2 EQU CYREG_PRT15_DM2
ISO_DI0__DR EQU CYREG_PRT15_DR
ISO_DI0__INP_DIS EQU CYREG_PRT15_INP_DIS
ISO_DI0__LCD_COM_SEG EQU CYREG_PRT15_LCD_COM_SEG
ISO_DI0__LCD_EN EQU CYREG_PRT15_LCD_EN
ISO_DI0__MASK EQU 0x08
ISO_DI0__P15_3__MASK EQU 0x08
ISO_DI0__P15_3__PC EQU CYREG_IO_PC_PRT15_PC3
ISO_DI0__P15_3__PORT EQU 15
ISO_DI0__P15_3__SHIFT EQU 3
ISO_DI0__PORT EQU 15
ISO_DI0__PRT EQU CYREG_PRT15_PRT
ISO_DI0__PRTDSI__CAPS_SEL EQU CYREG_PRT15_CAPS_SEL
ISO_DI0__PRTDSI__DBL_SYNC_IN EQU CYREG_PRT15_DBL_SYNC_IN
ISO_DI0__PRTDSI__OE_SEL0 EQU CYREG_PRT15_OE_SEL0
ISO_DI0__PRTDSI__OE_SEL1 EQU CYREG_PRT15_OE_SEL1
ISO_DI0__PRTDSI__OUT_SEL0 EQU CYREG_PRT15_OUT_SEL0
ISO_DI0__PRTDSI__OUT_SEL1 EQU CYREG_PRT15_OUT_SEL1
ISO_DI0__PRTDSI__SYNC_OUT EQU CYREG_PRT15_SYNC_OUT
ISO_DI0__PS EQU CYREG_PRT15_PS
ISO_DI0__SHIFT EQU 3
ISO_DI0__SLW EQU CYREG_PRT15_SLW

; ISO_DI1
ISO_DI1__0__MASK EQU 0x04
ISO_DI1__0__PC EQU CYREG_IO_PC_PRT15_PC2
ISO_DI1__0__PORT EQU 15
ISO_DI1__0__SHIFT EQU 2
ISO_DI1__AG EQU CYREG_PRT15_AG
ISO_DI1__AMUX EQU CYREG_PRT15_AMUX
ISO_DI1__BIE EQU CYREG_PRT15_BIE
ISO_DI1__BIT_MASK EQU CYREG_PRT15_BIT_MASK
ISO_DI1__BYP EQU CYREG_PRT15_BYP
ISO_DI1__CTL EQU CYREG_PRT15_CTL
ISO_DI1__DM0 EQU CYREG_PRT15_DM0
ISO_DI1__DM1 EQU CYREG_PRT15_DM1
ISO_DI1__DM2 EQU CYREG_PRT15_DM2
ISO_DI1__DR EQU CYREG_PRT15_DR
ISO_DI1__INP_DIS EQU CYREG_PRT15_INP_DIS
ISO_DI1__LCD_COM_SEG EQU CYREG_PRT15_LCD_COM_SEG
ISO_DI1__LCD_EN EQU CYREG_PRT15_LCD_EN
ISO_DI1__MASK EQU 0x04
ISO_DI1__P15_2__MASK EQU 0x04
ISO_DI1__P15_2__PC EQU CYREG_IO_PC_PRT15_PC2
ISO_DI1__P15_2__PORT EQU 15
ISO_DI1__P15_2__SHIFT EQU 2
ISO_DI1__PORT EQU 15
ISO_DI1__PRT EQU CYREG_PRT15_PRT
ISO_DI1__PRTDSI__CAPS_SEL EQU CYREG_PRT15_CAPS_SEL
ISO_DI1__PRTDSI__DBL_SYNC_IN EQU CYREG_PRT15_DBL_SYNC_IN
ISO_DI1__PRTDSI__OE_SEL0 EQU CYREG_PRT15_OE_SEL0
ISO_DI1__PRTDSI__OE_SEL1 EQU CYREG_PRT15_OE_SEL1
ISO_DI1__PRTDSI__OUT_SEL0 EQU CYREG_PRT15_OUT_SEL0
ISO_DI1__PRTDSI__OUT_SEL1 EQU CYREG_PRT15_OUT_SEL1
ISO_DI1__PRTDSI__SYNC_OUT EQU CYREG_PRT15_SYNC_OUT
ISO_DI1__PS EQU CYREG_PRT15_PS
ISO_DI1__SHIFT EQU 2
ISO_DI1__SLW EQU CYREG_PRT15_SLW

; ISO_DI2
ISO_DI2__0__MASK EQU 0x80
ISO_DI2__0__PC EQU CYREG_PRT3_PC7
ISO_DI2__0__PORT EQU 3
ISO_DI2__0__SHIFT EQU 7
ISO_DI2__AG EQU CYREG_PRT3_AG
ISO_DI2__AMUX EQU CYREG_PRT3_AMUX
ISO_DI2__BIE EQU CYREG_PRT3_BIE
ISO_DI2__BIT_MASK EQU CYREG_PRT3_BIT_MASK
ISO_DI2__BYP EQU CYREG_PRT3_BYP
ISO_DI2__CTL EQU CYREG_PRT3_CTL
ISO_DI2__DM0 EQU CYREG_PRT3_DM0
ISO_DI2__DM1 EQU CYREG_PRT3_DM1
ISO_DI2__DM2 EQU CYREG_PRT3_DM2
ISO_DI2__DR EQU CYREG_PRT3_DR
ISO_DI2__INP_DIS EQU CYREG_PRT3_INP_DIS
ISO_DI2__LCD_COM_SEG EQU CYREG_PRT3_LCD_COM_SEG
ISO_DI2__LCD_EN EQU CYREG_PRT3_LCD_EN
ISO_DI2__MASK EQU 0x80
ISO_DI2__P3_7__MASK EQU 0x80
ISO_DI2__P3_7__PC EQU CYREG_PRT3_PC7
ISO_DI2__P3_7__PORT EQU 3
ISO_DI2__P3_7__SHIFT EQU 7
ISO_DI2__PORT EQU 3
ISO_DI2__PRT EQU CYREG_PRT3_PRT
ISO_DI2__PRTDSI__CAPS_SEL EQU CYREG_PRT3_CAPS_SEL
ISO_DI2__PRTDSI__DBL_SYNC_IN EQU CYREG_PRT3_DBL_SYNC_IN
ISO_DI2__PRTDSI__OE_SEL0 EQU CYREG_PRT3_OE_SEL0
ISO_DI2__PRTDSI__OE_SEL1 EQU CYREG_PRT3_OE_SEL1
ISO_DI2__PRTDSI__OUT_SEL0 EQU CYREG_PRT3_OUT_SEL0
ISO_DI2__PRTDSI__OUT_SEL1 EQU CYREG_PRT3_OUT_SEL1
ISO_DI2__PRTDSI__SYNC_OUT EQU CYREG_PRT3_SYNC_OUT
ISO_DI2__PS EQU CYREG_PRT3_PS
ISO_DI2__SHIFT EQU 7
ISO_DI2__SLW EQU CYREG_PRT3_SLW

; ISO_SCS
ISO_SCS__0__MASK EQU 0x08
ISO_SCS__0__PC EQU CYREG_PRT3_PC3
ISO_SCS__0__PORT EQU 3
ISO_SCS__0__SHIFT EQU 3
ISO_SCS__AG EQU CYREG_PRT3_AG
ISO_SCS__AMUX EQU CYREG_PRT3_AMUX
ISO_SCS__BIE EQU CYREG_PRT3_BIE
ISO_SCS__BIT_MASK EQU CYREG_PRT3_BIT_MASK
ISO_SCS__BYP EQU CYREG_PRT3_BYP
ISO_SCS__CTL EQU CYREG_PRT3_CTL
ISO_SCS__DM0 EQU CYREG_PRT3_DM0
ISO_SCS__DM1 EQU CYREG_PRT3_DM1
ISO_SCS__DM2 EQU CYREG_PRT3_DM2
ISO_SCS__DR EQU CYREG_PRT3_DR
ISO_SCS__INP_DIS EQU CYREG_PRT3_INP_DIS
ISO_SCS__LCD_COM_SEG EQU CYREG_PRT3_LCD_COM_SEG
ISO_SCS__LCD_EN EQU CYREG_PRT3_LCD_EN
ISO_SCS__MASK EQU 0x08
ISO_SCS__P3_3__MASK EQU 0x08
ISO_SCS__P3_3__PC EQU CYREG_PRT3_PC3
ISO_SCS__P3_3__PORT EQU 3
ISO_SCS__P3_3__SHIFT EQU 3
ISO_SCS__PORT EQU 3
ISO_SCS__PRT EQU CYREG_PRT3_PRT
ISO_SCS__PRTDSI__CAPS_SEL EQU CYREG_PRT3_CAPS_SEL
ISO_SCS__PRTDSI__DBL_SYNC_IN EQU CYREG_PRT3_DBL_SYNC_IN
ISO_SCS__PRTDSI__OE_SEL0 EQU CYREG_PRT3_OE_SEL0
ISO_SCS__PRTDSI__OE_SEL1 EQU CYREG_PRT3_OE_SEL1
ISO_SCS__PRTDSI__OUT_SEL0 EQU CYREG_PRT3_OUT_SEL0
ISO_SCS__PRTDSI__OUT_SEL1 EQU CYREG_PRT3_OUT_SEL1
ISO_SCS__PRTDSI__SYNC_OUT EQU CYREG_PRT3_SYNC_OUT
ISO_SCS__PS EQU CYREG_PRT3_PS
ISO_SCS__SHIFT EQU 3
ISO_SCS__SLW EQU CYREG_PRT3_SLW

; ISO_SDI
ISO_SDI__0__MASK EQU 0x10
ISO_SDI__0__PC EQU CYREG_PRT3_PC4
ISO_SDI__0__PORT EQU 3
ISO_SDI__0__SHIFT EQU 4
ISO_SDI__AG EQU CYREG_PRT3_AG
ISO_SDI__AMUX EQU CYREG_PRT3_AMUX
ISO_SDI__BIE EQU CYREG_PRT3_BIE
ISO_SDI__BIT_MASK EQU CYREG_PRT3_BIT_MASK
ISO_SDI__BYP EQU CYREG_PRT3_BYP
ISO_SDI__CTL EQU CYREG_PRT3_CTL
ISO_SDI__DM0 EQU CYREG_PRT3_DM0
ISO_SDI__DM1 EQU CYREG_PRT3_DM1
ISO_SDI__DM2 EQU CYREG_PRT3_DM2
ISO_SDI__DR EQU CYREG_PRT3_DR
ISO_SDI__INP_DIS EQU CYREG_PRT3_INP_DIS
ISO_SDI__LCD_COM_SEG EQU CYREG_PRT3_LCD_COM_SEG
ISO_SDI__LCD_EN EQU CYREG_PRT3_LCD_EN
ISO_SDI__MASK EQU 0x10
ISO_SDI__P3_4__MASK EQU 0x10
ISO_SDI__P3_4__PC EQU CYREG_PRT3_PC4
ISO_SDI__P3_4__PORT EQU 3
ISO_SDI__P3_4__SHIFT EQU 4
ISO_SDI__PORT EQU 3
ISO_SDI__PRT EQU CYREG_PRT3_PRT
ISO_SDI__PRTDSI__CAPS_SEL EQU CYREG_PRT3_CAPS_SEL
ISO_SDI__PRTDSI__DBL_SYNC_IN EQU CYREG_PRT3_DBL_SYNC_IN
ISO_SDI__PRTDSI__OE_SEL0 EQU CYREG_PRT3_OE_SEL0
ISO_SDI__PRTDSI__OE_SEL1 EQU CYREG_PRT3_OE_SEL1
ISO_SDI__PRTDSI__OUT_SEL0 EQU CYREG_PRT3_OUT_SEL0
ISO_SDI__PRTDSI__OUT_SEL1 EQU CYREG_PRT3_OUT_SEL1
ISO_SDI__PRTDSI__SYNC_OUT EQU CYREG_PRT3_SYNC_OUT
ISO_SDI__PS EQU CYREG_PRT3_PS
ISO_SDI__SHIFT EQU 4
ISO_SDI__SLW EQU CYREG_PRT3_SLW

; ISO_SDO
ISO_SDO__0__MASK EQU 0x20
ISO_SDO__0__PC EQU CYREG_PRT3_PC5
ISO_SDO__0__PORT EQU 3
ISO_SDO__0__SHIFT EQU 5
ISO_SDO__AG EQU CYREG_PRT3_AG
ISO_SDO__AMUX EQU CYREG_PRT3_AMUX
ISO_SDO__BIE EQU CYREG_PRT3_BIE
ISO_SDO__BIT_MASK EQU CYREG_PRT3_BIT_MASK
ISO_SDO__BYP EQU CYREG_PRT3_BYP
ISO_SDO__CTL EQU CYREG_PRT3_CTL
ISO_SDO__DM0 EQU CYREG_PRT3_DM0
ISO_SDO__DM1 EQU CYREG_PRT3_DM1
ISO_SDO__DM2 EQU CYREG_PRT3_DM2
ISO_SDO__DR EQU CYREG_PRT3_DR
ISO_SDO__INP_DIS EQU CYREG_PRT3_INP_DIS
ISO_SDO__LCD_COM_SEG EQU CYREG_PRT3_LCD_COM_SEG
ISO_SDO__LCD_EN EQU CYREG_PRT3_LCD_EN
ISO_SDO__MASK EQU 0x20
ISO_SDO__P3_5__MASK EQU 0x20
ISO_SDO__P3_5__PC EQU CYREG_PRT3_PC5
ISO_SDO__P3_5__PORT EQU 3
ISO_SDO__P3_5__SHIFT EQU 5
ISO_SDO__PORT EQU 3
ISO_SDO__PRT EQU CYREG_PRT3_PRT
ISO_SDO__PRTDSI__CAPS_SEL EQU CYREG_PRT3_CAPS_SEL
ISO_SDO__PRTDSI__DBL_SYNC_IN EQU CYREG_PRT3_DBL_SYNC_IN
ISO_SDO__PRTDSI__OE_SEL0 EQU CYREG_PRT3_OE_SEL0
ISO_SDO__PRTDSI__OE_SEL1 EQU CYREG_PRT3_OE_SEL1
ISO_SDO__PRTDSI__OUT_SEL0 EQU CYREG_PRT3_OUT_SEL0
ISO_SDO__PRTDSI__OUT_SEL1 EQU CYREG_PRT3_OUT_SEL1
ISO_SDO__PRTDSI__SYNC_OUT EQU CYREG_PRT3_SYNC_OUT
ISO_SDO__PS EQU CYREG_PRT3_PS
ISO_SDO__SHIFT EQU 5
ISO_SDO__SLW EQU CYREG_PRT3_SLW

; RL1_CTR
RL1_CTR__0__MASK EQU 0x04
RL1_CTR__0__PC EQU CYREG_PRT0_PC2
RL1_CTR__0__PORT EQU 0
RL1_CTR__0__SHIFT EQU 2
RL1_CTR__AG EQU CYREG_PRT0_AG
RL1_CTR__AMUX EQU CYREG_PRT0_AMUX
RL1_CTR__BIE EQU CYREG_PRT0_BIE
RL1_CTR__BIT_MASK EQU CYREG_PRT0_BIT_MASK
RL1_CTR__BYP EQU CYREG_PRT0_BYP
RL1_CTR__CTL EQU CYREG_PRT0_CTL
RL1_CTR__DM0 EQU CYREG_PRT0_DM0
RL1_CTR__DM1 EQU CYREG_PRT0_DM1
RL1_CTR__DM2 EQU CYREG_PRT0_DM2
RL1_CTR__DR EQU CYREG_PRT0_DR
RL1_CTR__INP_DIS EQU CYREG_PRT0_INP_DIS
RL1_CTR__LCD_COM_SEG EQU CYREG_PRT0_LCD_COM_SEG
RL1_CTR__LCD_EN EQU CYREG_PRT0_LCD_EN
RL1_CTR__MASK EQU 0x04
RL1_CTR__P0_2__MASK EQU 0x04
RL1_CTR__P0_2__PC EQU CYREG_PRT0_PC2
RL1_CTR__P0_2__PORT EQU 0
RL1_CTR__P0_2__SHIFT EQU 2
RL1_CTR__PORT EQU 0
RL1_CTR__PRT EQU CYREG_PRT0_PRT
RL1_CTR__PRTDSI__CAPS_SEL EQU CYREG_PRT0_CAPS_SEL
RL1_CTR__PRTDSI__DBL_SYNC_IN EQU CYREG_PRT0_DBL_SYNC_IN
RL1_CTR__PRTDSI__OE_SEL0 EQU CYREG_PRT0_OE_SEL0
RL1_CTR__PRTDSI__OE_SEL1 EQU CYREG_PRT0_OE_SEL1
RL1_CTR__PRTDSI__OUT_SEL0 EQU CYREG_PRT0_OUT_SEL0
RL1_CTR__PRTDSI__OUT_SEL1 EQU CYREG_PRT0_OUT_SEL1
RL1_CTR__PRTDSI__SYNC_OUT EQU CYREG_PRT0_SYNC_OUT
RL1_CTR__PS EQU CYREG_PRT0_PS
RL1_CTR__SHIFT EQU 2
RL1_CTR__SLW EQU CYREG_PRT0_SLW

; RL2_CTR
RL2_CTR__0__MASK EQU 0x02
RL2_CTR__0__PC EQU CYREG_PRT0_PC1
RL2_CTR__0__PORT EQU 0
RL2_CTR__0__SHIFT EQU 1
RL2_CTR__AG EQU CYREG_PRT0_AG
RL2_CTR__AMUX EQU CYREG_PRT0_AMUX
RL2_CTR__BIE EQU CYREG_PRT0_BIE
RL2_CTR__BIT_MASK EQU CYREG_PRT0_BIT_MASK
RL2_CTR__BYP EQU CYREG_PRT0_BYP
RL2_CTR__CTL EQU CYREG_PRT0_CTL
RL2_CTR__DM0 EQU CYREG_PRT0_DM0
RL2_CTR__DM1 EQU CYREG_PRT0_DM1
RL2_CTR__DM2 EQU CYREG_PRT0_DM2
RL2_CTR__DR EQU CYREG_PRT0_DR
RL2_CTR__INP_DIS EQU CYREG_PRT0_INP_DIS
RL2_CTR__LCD_COM_SEG EQU CYREG_PRT0_LCD_COM_SEG
RL2_CTR__LCD_EN EQU CYREG_PRT0_LCD_EN
RL2_CTR__MASK EQU 0x02
RL2_CTR__P0_1__MASK EQU 0x02
RL2_CTR__P0_1__PC EQU CYREG_PRT0_PC1
RL2_CTR__P0_1__PORT EQU 0
RL2_CTR__P0_1__SHIFT EQU 1
RL2_CTR__PORT EQU 0
RL2_CTR__PRT EQU CYREG_PRT0_PRT
RL2_CTR__PRTDSI__CAPS_SEL EQU CYREG_PRT0_CAPS_SEL
RL2_CTR__PRTDSI__DBL_SYNC_IN EQU CYREG_PRT0_DBL_SYNC_IN
RL2_CTR__PRTDSI__OE_SEL0 EQU CYREG_PRT0_OE_SEL0
RL2_CTR__PRTDSI__OE_SEL1 EQU CYREG_PRT0_OE_SEL1
RL2_CTR__PRTDSI__OUT_SEL0 EQU CYREG_PRT0_OUT_SEL0
RL2_CTR__PRTDSI__OUT_SEL1 EQU CYREG_PRT0_OUT_SEL1
RL2_CTR__PRTDSI__SYNC_OUT EQU CYREG_PRT0_SYNC_OUT
RL2_CTR__PS EQU CYREG_PRT0_PS
RL2_CTR__SHIFT EQU 1
RL2_CTR__SLW EQU CYREG_PRT0_SLW

; RL3_CTR
RL3_CTR__0__MASK EQU 0x01
RL3_CTR__0__PC EQU CYREG_PRT0_PC0
RL3_CTR__0__PORT EQU 0
RL3_CTR__0__SHIFT EQU 0
RL3_CTR__AG EQU CYREG_PRT0_AG
RL3_CTR__AMUX EQU CYREG_PRT0_AMUX
RL3_CTR__BIE EQU CYREG_PRT0_BIE
RL3_CTR__BIT_MASK EQU CYREG_PRT0_BIT_MASK
RL3_CTR__BYP EQU CYREG_PRT0_BYP
RL3_CTR__CTL EQU CYREG_PRT0_CTL
RL3_CTR__DM0 EQU CYREG_PRT0_DM0
RL3_CTR__DM1 EQU CYREG_PRT0_DM1
RL3_CTR__DM2 EQU CYREG_PRT0_DM2
RL3_CTR__DR EQU CYREG_PRT0_DR
RL3_CTR__INP_DIS EQU CYREG_PRT0_INP_DIS
RL3_CTR__LCD_COM_SEG EQU CYREG_PRT0_LCD_COM_SEG
RL3_CTR__LCD_EN EQU CYREG_PRT0_LCD_EN
RL3_CTR__MASK EQU 0x01
RL3_CTR__P0_0__MASK EQU 0x01
RL3_CTR__P0_0__PC EQU CYREG_PRT0_PC0
RL3_CTR__P0_0__PORT EQU 0
RL3_CTR__P0_0__SHIFT EQU 0
RL3_CTR__PORT EQU 0
RL3_CTR__PRT EQU CYREG_PRT0_PRT
RL3_CTR__PRTDSI__CAPS_SEL EQU CYREG_PRT0_CAPS_SEL
RL3_CTR__PRTDSI__DBL_SYNC_IN EQU CYREG_PRT0_DBL_SYNC_IN
RL3_CTR__PRTDSI__OE_SEL0 EQU CYREG_PRT0_OE_SEL0
RL3_CTR__PRTDSI__OE_SEL1 EQU CYREG_PRT0_OE_SEL1
RL3_CTR__PRTDSI__OUT_SEL0 EQU CYREG_PRT0_OUT_SEL0
RL3_CTR__PRTDSI__OUT_SEL1 EQU CYREG_PRT0_OUT_SEL1
RL3_CTR__PRTDSI__SYNC_OUT EQU CYREG_PRT0_SYNC_OUT
RL3_CTR__PS EQU CYREG_PRT0_PS
RL3_CTR__SHIFT EQU 0
RL3_CTR__SLW EQU CYREG_PRT0_SLW

; RL4_CTR
RL4_CTR__0__MASK EQU 0x02
RL4_CTR__0__PC EQU CYREG_PRT4_PC1
RL4_CTR__0__PORT EQU 4
RL4_CTR__0__SHIFT EQU 1
RL4_CTR__AG EQU CYREG_PRT4_AG
RL4_CTR__AMUX EQU CYREG_PRT4_AMUX
RL4_CTR__BIE EQU CYREG_PRT4_BIE
RL4_CTR__BIT_MASK EQU CYREG_PRT4_BIT_MASK
RL4_CTR__BYP EQU CYREG_PRT4_BYP
RL4_CTR__CTL EQU CYREG_PRT4_CTL
RL4_CTR__DM0 EQU CYREG_PRT4_DM0
RL4_CTR__DM1 EQU CYREG_PRT4_DM1
RL4_CTR__DM2 EQU CYREG_PRT4_DM2
RL4_CTR__DR EQU CYREG_PRT4_DR
RL4_CTR__INP_DIS EQU CYREG_PRT4_INP_DIS
RL4_CTR__LCD_COM_SEG EQU CYREG_PRT4_LCD_COM_SEG
RL4_CTR__LCD_EN EQU CYREG_PRT4_LCD_EN
RL4_CTR__MASK EQU 0x02
RL4_CTR__P4_1__MASK EQU 0x02
RL4_CTR__P4_1__PC EQU CYREG_PRT4_PC1
RL4_CTR__P4_1__PORT EQU 4
RL4_CTR__P4_1__SHIFT EQU 1
RL4_CTR__PORT EQU 4
RL4_CTR__PRT EQU CYREG_PRT4_PRT
RL4_CTR__PRTDSI__CAPS_SEL EQU CYREG_PRT4_CAPS_SEL
RL4_CTR__PRTDSI__DBL_SYNC_IN EQU CYREG_PRT4_DBL_SYNC_IN
RL4_CTR__PRTDSI__OE_SEL0 EQU CYREG_PRT4_OE_SEL0
RL4_CTR__PRTDSI__OE_SEL1 EQU CYREG_PRT4_OE_SEL1
RL4_CTR__PRTDSI__OUT_SEL0 EQU CYREG_PRT4_OUT_SEL0
RL4_CTR__PRTDSI__OUT_SEL1 EQU CYREG_PRT4_OUT_SEL1
RL4_CTR__PRTDSI__SYNC_OUT EQU CYREG_PRT4_SYNC_OUT
RL4_CTR__PS EQU CYREG_PRT4_PS
RL4_CTR__SHIFT EQU 1
RL4_CTR__SLW EQU CYREG_PRT4_SLW

; RL5_CTR
RL5_CTR__0__MASK EQU 0x01
RL5_CTR__0__PC EQU CYREG_PRT4_PC0
RL5_CTR__0__PORT EQU 4
RL5_CTR__0__SHIFT EQU 0
RL5_CTR__AG EQU CYREG_PRT4_AG
RL5_CTR__AMUX EQU CYREG_PRT4_AMUX
RL5_CTR__BIE EQU CYREG_PRT4_BIE
RL5_CTR__BIT_MASK EQU CYREG_PRT4_BIT_MASK
RL5_CTR__BYP EQU CYREG_PRT4_BYP
RL5_CTR__CTL EQU CYREG_PRT4_CTL
RL5_CTR__DM0 EQU CYREG_PRT4_DM0
RL5_CTR__DM1 EQU CYREG_PRT4_DM1
RL5_CTR__DM2 EQU CYREG_PRT4_DM2
RL5_CTR__DR EQU CYREG_PRT4_DR
RL5_CTR__INP_DIS EQU CYREG_PRT4_INP_DIS
RL5_CTR__LCD_COM_SEG EQU CYREG_PRT4_LCD_COM_SEG
RL5_CTR__LCD_EN EQU CYREG_PRT4_LCD_EN
RL5_CTR__MASK EQU 0x01
RL5_CTR__P4_0__MASK EQU 0x01
RL5_CTR__P4_0__PC EQU CYREG_PRT4_PC0
RL5_CTR__P4_0__PORT EQU 4
RL5_CTR__P4_0__SHIFT EQU 0
RL5_CTR__PORT EQU 4
RL5_CTR__PRT EQU CYREG_PRT4_PRT
RL5_CTR__PRTDSI__CAPS_SEL EQU CYREG_PRT4_CAPS_SEL
RL5_CTR__PRTDSI__DBL_SYNC_IN EQU CYREG_PRT4_DBL_SYNC_IN
RL5_CTR__PRTDSI__OE_SEL0 EQU CYREG_PRT4_OE_SEL0
RL5_CTR__PRTDSI__OE_SEL1 EQU CYREG_PRT4_OE_SEL1
RL5_CTR__PRTDSI__OUT_SEL0 EQU CYREG_PRT4_OUT_SEL0
RL5_CTR__PRTDSI__OUT_SEL1 EQU CYREG_PRT4_OUT_SEL1
RL5_CTR__PRTDSI__SYNC_OUT EQU CYREG_PRT4_SYNC_OUT
RL5_CTR__PS EQU CYREG_PRT4_PS
RL5_CTR__SHIFT EQU 0
RL5_CTR__SLW EQU CYREG_PRT4_SLW

; RL6_CTR
RL6_CTR__0__MASK EQU 0x08
RL6_CTR__0__PC EQU CYREG_PRT12_PC3
RL6_CTR__0__PORT EQU 12
RL6_CTR__0__SHIFT EQU 3
RL6_CTR__AG EQU CYREG_PRT12_AG
RL6_CTR__BIE EQU CYREG_PRT12_BIE
RL6_CTR__BIT_MASK EQU CYREG_PRT12_BIT_MASK
RL6_CTR__BYP EQU CYREG_PRT12_BYP
RL6_CTR__DM0 EQU CYREG_PRT12_DM0
RL6_CTR__DM1 EQU CYREG_PRT12_DM1
RL6_CTR__DM2 EQU CYREG_PRT12_DM2
RL6_CTR__DR EQU CYREG_PRT12_DR
RL6_CTR__INP_DIS EQU CYREG_PRT12_INP_DIS
RL6_CTR__MASK EQU 0x08
RL6_CTR__P12_3__MASK EQU 0x08
RL6_CTR__P12_3__PC EQU CYREG_PRT12_PC3
RL6_CTR__P12_3__PORT EQU 12
RL6_CTR__P12_3__SHIFT EQU 3
RL6_CTR__PORT EQU 12
RL6_CTR__PRT EQU CYREG_PRT12_PRT
RL6_CTR__PRTDSI__DBL_SYNC_IN EQU CYREG_PRT12_DBL_SYNC_IN
RL6_CTR__PRTDSI__OE_SEL0 EQU CYREG_PRT12_OE_SEL0
RL6_CTR__PRTDSI__OE_SEL1 EQU CYREG_PRT12_OE_SEL1
RL6_CTR__PRTDSI__OUT_SEL0 EQU CYREG_PRT12_OUT_SEL0
RL6_CTR__PRTDSI__OUT_SEL1 EQU CYREG_PRT12_OUT_SEL1
RL6_CTR__PRTDSI__SYNC_OUT EQU CYREG_PRT12_SYNC_OUT
RL6_CTR__PS EQU CYREG_PRT12_PS
RL6_CTR__SHIFT EQU 3
RL6_CTR__SIO_CFG EQU CYREG_PRT12_SIO_CFG
RL6_CTR__SIO_DIFF EQU CYREG_PRT12_SIO_DIFF
RL6_CTR__SIO_HYST_EN EQU CYREG_PRT12_SIO_HYST_EN
RL6_CTR__SIO_REG_HIFREQ EQU CYREG_PRT12_SIO_REG_HIFREQ
RL6_CTR__SLW EQU CYREG_PRT12_SLW

; RL7_CTR
RL7_CTR__0__MASK EQU 0x04
RL7_CTR__0__PC EQU CYREG_PRT12_PC2
RL7_CTR__0__PORT EQU 12
RL7_CTR__0__SHIFT EQU 2
RL7_CTR__AG EQU CYREG_PRT12_AG
RL7_CTR__BIE EQU CYREG_PRT12_BIE
RL7_CTR__BIT_MASK EQU CYREG_PRT12_BIT_MASK
RL7_CTR__BYP EQU CYREG_PRT12_BYP
RL7_CTR__DM0 EQU CYREG_PRT12_DM0
RL7_CTR__DM1 EQU CYREG_PRT12_DM1
RL7_CTR__DM2 EQU CYREG_PRT12_DM2
RL7_CTR__DR EQU CYREG_PRT12_DR
RL7_CTR__INP_DIS EQU CYREG_PRT12_INP_DIS
RL7_CTR__MASK EQU 0x04
RL7_CTR__P12_2__MASK EQU 0x04
RL7_CTR__P12_2__PC EQU CYREG_PRT12_PC2
RL7_CTR__P12_2__PORT EQU 12
RL7_CTR__P12_2__SHIFT EQU 2
RL7_CTR__PORT EQU 12
RL7_CTR__PRT EQU CYREG_PRT12_PRT
RL7_CTR__PRTDSI__DBL_SYNC_IN EQU CYREG_PRT12_DBL_SYNC_IN
RL7_CTR__PRTDSI__OE_SEL0 EQU CYREG_PRT12_OE_SEL0
RL7_CTR__PRTDSI__OE_SEL1 EQU CYREG_PRT12_OE_SEL1
RL7_CTR__PRTDSI__OUT_SEL0 EQU CYREG_PRT12_OUT_SEL0
RL7_CTR__PRTDSI__OUT_SEL1 EQU CYREG_PRT12_OUT_SEL1
RL7_CTR__PRTDSI__SYNC_OUT EQU CYREG_PRT12_SYNC_OUT
RL7_CTR__PS EQU CYREG_PRT12_PS
RL7_CTR__SHIFT EQU 2
RL7_CTR__SIO_CFG EQU CYREG_PRT12_SIO_CFG
RL7_CTR__SIO_DIFF EQU CYREG_PRT12_SIO_DIFF
RL7_CTR__SIO_HYST_EN EQU CYREG_PRT12_SIO_HYST_EN
RL7_CTR__SIO_REG_HIFREQ EQU CYREG_PRT12_SIO_REG_HIFREQ
RL7_CTR__SLW EQU CYREG_PRT12_SLW

; DOut
DOut__0__MASK EQU 0x01
DOut__0__PC EQU CYREG_PRT5_PC0
DOut__0__PORT EQU 5
DOut__0__SHIFT EQU 0
DOut__AG EQU CYREG_PRT5_AG
DOut__AMUX EQU CYREG_PRT5_AMUX
DOut__BIE EQU CYREG_PRT5_BIE
DOut__BIT_MASK EQU CYREG_PRT5_BIT_MASK
DOut__BYP EQU CYREG_PRT5_BYP
DOut__CTL EQU CYREG_PRT5_CTL
DOut__DM0 EQU CYREG_PRT5_DM0
DOut__DM1 EQU CYREG_PRT5_DM1
DOut__DM2 EQU CYREG_PRT5_DM2
DOut__DR EQU CYREG_PRT5_DR
DOut__INP_DIS EQU CYREG_PRT5_INP_DIS
DOut__LCD_COM_SEG EQU CYREG_PRT5_LCD_COM_SEG
DOut__LCD_EN EQU CYREG_PRT5_LCD_EN
DOut__MASK EQU 0x01
DOut__P5_0__MASK EQU 0x01
DOut__P5_0__PC EQU CYREG_PRT5_PC0
DOut__P5_0__PORT EQU 5
DOut__P5_0__SHIFT EQU 0
DOut__PORT EQU 5
DOut__PRT EQU CYREG_PRT5_PRT
DOut__PRTDSI__CAPS_SEL EQU CYREG_PRT5_CAPS_SEL
DOut__PRTDSI__DBL_SYNC_IN EQU CYREG_PRT5_DBL_SYNC_IN
DOut__PRTDSI__OE_SEL0 EQU CYREG_PRT5_OE_SEL0
DOut__PRTDSI__OE_SEL1 EQU CYREG_PRT5_OE_SEL1
DOut__PRTDSI__OUT_SEL0 EQU CYREG_PRT5_OUT_SEL0
DOut__PRTDSI__OUT_SEL1 EQU CYREG_PRT5_OUT_SEL1
DOut__PRTDSI__SYNC_OUT EQU CYREG_PRT5_SYNC_OUT
DOut__PS EQU CYREG_PRT5_PS
DOut__SHIFT EQU 0
DOut__SLW EQU CYREG_PRT5_SLW

; DIn
DIn__0__MASK EQU 0x02
DIn__0__PC EQU CYREG_PRT5_PC1
DIn__0__PORT EQU 5
DIn__0__SHIFT EQU 1
DIn__AG EQU CYREG_PRT5_AG
DIn__AMUX EQU CYREG_PRT5_AMUX
DIn__BIE EQU CYREG_PRT5_BIE
DIn__BIT_MASK EQU CYREG_PRT5_BIT_MASK
DIn__BYP EQU CYREG_PRT5_BYP
DIn__CTL EQU CYREG_PRT5_CTL
DIn__DM0 EQU CYREG_PRT5_DM0
DIn__DM1 EQU CYREG_PRT5_DM1
DIn__DM2 EQU CYREG_PRT5_DM2
DIn__DR EQU CYREG_PRT5_DR
DIn__INP_DIS EQU CYREG_PRT5_INP_DIS
DIn__LCD_COM_SEG EQU CYREG_PRT5_LCD_COM_SEG
DIn__LCD_EN EQU CYREG_PRT5_LCD_EN
DIn__MASK EQU 0x02
DIn__P5_1__MASK EQU 0x02
DIn__P5_1__PC EQU CYREG_PRT5_PC1
DIn__P5_1__PORT EQU 5
DIn__P5_1__SHIFT EQU 1
DIn__PORT EQU 5
DIn__PRT EQU CYREG_PRT5_PRT
DIn__PRTDSI__CAPS_SEL EQU CYREG_PRT5_CAPS_SEL
DIn__PRTDSI__DBL_SYNC_IN EQU CYREG_PRT5_DBL_SYNC_IN
DIn__PRTDSI__OE_SEL0 EQU CYREG_PRT5_OE_SEL0
DIn__PRTDSI__OE_SEL1 EQU CYREG_PRT5_OE_SEL1
DIn__PRTDSI__OUT_SEL0 EQU CYREG_PRT5_OUT_SEL0
DIn__PRTDSI__OUT_SEL1 EQU CYREG_PRT5_OUT_SEL1
DIn__PRTDSI__SYNC_OUT EQU CYREG_PRT5_SYNC_OUT
DIn__PS EQU CYREG_PRT5_PS
DIn__SHIFT EQU 1
DIn__SLW EQU CYREG_PRT5_SLW

; CK
CK__0__MASK EQU 0x04
CK__0__PC EQU CYREG_PRT5_PC2
CK__0__PORT EQU 5
CK__0__SHIFT EQU 2
CK__AG EQU CYREG_PRT5_AG
CK__AMUX EQU CYREG_PRT5_AMUX
CK__BIE EQU CYREG_PRT5_BIE
CK__BIT_MASK EQU CYREG_PRT5_BIT_MASK
CK__BYP EQU CYREG_PRT5_BYP
CK__CTL EQU CYREG_PRT5_CTL
CK__DM0 EQU CYREG_PRT5_DM0
CK__DM1 EQU CYREG_PRT5_DM1
CK__DM2 EQU CYREG_PRT5_DM2
CK__DR EQU CYREG_PRT5_DR
CK__INP_DIS EQU CYREG_PRT5_INP_DIS
CK__LCD_COM_SEG EQU CYREG_PRT5_LCD_COM_SEG
CK__LCD_EN EQU CYREG_PRT5_LCD_EN
CK__MASK EQU 0x04
CK__P5_2__MASK EQU 0x04
CK__P5_2__PC EQU CYREG_PRT5_PC2
CK__P5_2__PORT EQU 5
CK__P5_2__SHIFT EQU 2
CK__PORT EQU 5
CK__PRT EQU CYREG_PRT5_PRT
CK__PRTDSI__CAPS_SEL EQU CYREG_PRT5_CAPS_SEL
CK__PRTDSI__DBL_SYNC_IN EQU CYREG_PRT5_DBL_SYNC_IN
CK__PRTDSI__OE_SEL0 EQU CYREG_PRT5_OE_SEL0
CK__PRTDSI__OE_SEL1 EQU CYREG_PRT5_OE_SEL1
CK__PRTDSI__OUT_SEL0 EQU CYREG_PRT5_OUT_SEL0
CK__PRTDSI__OUT_SEL1 EQU CYREG_PRT5_OUT_SEL1
CK__PRTDSI__SYNC_OUT EQU CYREG_PRT5_SYNC_OUT
CK__PS EQU CYREG_PRT5_PS
CK__SHIFT EQU 2
CK__SLW EQU CYREG_PRT5_SLW

; CS
CS__0__MASK EQU 0x08
CS__0__PC EQU CYREG_PRT5_PC3
CS__0__PORT EQU 5
CS__0__SHIFT EQU 3
CS__AG EQU CYREG_PRT5_AG
CS__AMUX EQU CYREG_PRT5_AMUX
CS__BIE EQU CYREG_PRT5_BIE
CS__BIT_MASK EQU CYREG_PRT5_BIT_MASK
CS__BYP EQU CYREG_PRT5_BYP
CS__CTL EQU CYREG_PRT5_CTL
CS__DM0 EQU CYREG_PRT5_DM0
CS__DM1 EQU CYREG_PRT5_DM1
CS__DM2 EQU CYREG_PRT5_DM2
CS__DR EQU CYREG_PRT5_DR
CS__INP_DIS EQU CYREG_PRT5_INP_DIS
CS__LCD_COM_SEG EQU CYREG_PRT5_LCD_COM_SEG
CS__LCD_EN EQU CYREG_PRT5_LCD_EN
CS__MASK EQU 0x08
CS__P5_3__MASK EQU 0x08
CS__P5_3__PC EQU CYREG_PRT5_PC3
CS__P5_3__PORT EQU 5
CS__P5_3__SHIFT EQU 3
CS__PORT EQU 5
CS__PRT EQU CYREG_PRT5_PRT
CS__PRTDSI__CAPS_SEL EQU CYREG_PRT5_CAPS_SEL
CS__PRTDSI__DBL_SYNC_IN EQU CYREG_PRT5_DBL_SYNC_IN
CS__PRTDSI__OE_SEL0 EQU CYREG_PRT5_OE_SEL0
CS__PRTDSI__OE_SEL1 EQU CYREG_PRT5_OE_SEL1
CS__PRTDSI__OUT_SEL0 EQU CYREG_PRT5_OUT_SEL0
CS__PRTDSI__OUT_SEL1 EQU CYREG_PRT5_OUT_SEL1
CS__PRTDSI__SYNC_OUT EQU CYREG_PRT5_SYNC_OUT
CS__PS EQU CYREG_PRT5_PS
CS__SHIFT EQU 3
CS__SLW EQU CYREG_PRT5_SLW

; Miscellaneous
; -- WARNING: define names containing LEOPARD or PANTHER are deprecated and will be removed in a future release
CYDEV_DEBUGGING_DPS_SWD_SWV EQU 6
CYDEV_CONFIG_UNUSED_IO_AllowButWarn EQU 0
CYDEV_CONFIGURATION_MODE_DMA EQU 2
CYDEV_CONFIG_FASTBOOT_ENABLED EQU 1
CYDEV_CHIP_REV_LEOPARD_PRODUCTION EQU 3
CYDEV_CHIP_REVISION_3A_PRODUCTION EQU 3
CYDEV_CHIP_MEMBER_3A EQU 1
CYDEV_CHIP_FAMILY_PSOC3 EQU 1
CYDEV_CHIP_DIE_LEOPARD EQU 1
CYDEV_CHIP_DIE_EXPECT EQU CYDEV_CHIP_DIE_LEOPARD
BCLK__BUS_CLK__HZ EQU 24000000
BCLK__BUS_CLK__KHZ EQU 24000
BCLK__BUS_CLK__MHZ EQU 24
CYDEV_CHIP_DIE_ACTUAL EQU CYDEV_CHIP_DIE_EXPECT
CYDEV_CHIP_DIE_PANTHER EQU 3
CYDEV_CHIP_DIE_PSOC4A EQU 2
CYDEV_CHIP_DIE_PSOC5LP EQU 4
CYDEV_CHIP_DIE_UNKNOWN EQU 0
CYDEV_CHIP_FAMILY_PSOC4 EQU 2
CYDEV_CHIP_FAMILY_PSOC5 EQU 3
CYDEV_CHIP_FAMILY_UNKNOWN EQU 0
CYDEV_CHIP_FAMILY_USED EQU CYDEV_CHIP_FAMILY_PSOC3
CYDEV_CHIP_JTAG_ID EQU 0x1E08A069
CYDEV_CHIP_MEMBER_4A EQU 2
CYDEV_CHIP_MEMBER_5A EQU 3
CYDEV_CHIP_MEMBER_5B EQU 4
CYDEV_CHIP_MEMBER_UNKNOWN EQU 0
CYDEV_CHIP_MEMBER_USED EQU CYDEV_CHIP_MEMBER_3A
CYDEV_CHIP_REVISION_3A_ES1 EQU 0
CYDEV_CHIP_REVISION_3A_ES2 EQU 1
CYDEV_CHIP_REVISION_3A_ES3 EQU 3
CYDEV_CHIP_REVISION_4A_ES0 EQU 17
CYDEV_CHIP_REVISION_4A_PRODUCTION EQU 17
CYDEV_CHIP_REVISION_5A_ES0 EQU 0
CYDEV_CHIP_REVISION_5A_ES1 EQU 1
CYDEV_CHIP_REVISION_5A_PRODUCTION EQU 1
CYDEV_CHIP_REVISION_5B_ES0 EQU 0
CYDEV_CHIP_REVISION_5B_PRODUCTION EQU 0
CYDEV_CHIP_REVISION_USED EQU CYDEV_CHIP_REVISION_3A_PRODUCTION
CYDEV_CHIP_REV_EXPECT EQU CYDEV_CHIP_REV_LEOPARD_PRODUCTION
CYDEV_CHIP_REV_LEOPARD_ES1 EQU 0
CYDEV_CHIP_REV_LEOPARD_ES2 EQU 1
CYDEV_CHIP_REV_LEOPARD_ES3 EQU 3
CYDEV_CHIP_REV_PANTHER_ES0 EQU 0
CYDEV_CHIP_REV_PANTHER_ES1 EQU 1
CYDEV_CHIP_REV_PANTHER_PRODUCTION EQU 1
CYDEV_CHIP_REV_PSOC4A_ES0 EQU 17
CYDEV_CHIP_REV_PSOC4A_PRODUCTION EQU 17
CYDEV_CHIP_REV_PSOC5LP_ES0 EQU 0
CYDEV_CHIP_REV_PSOC5LP_PRODUCTION EQU 0
CYDEV_CONFIGURATION_CLEAR_SRAM EQU 1
CYDEV_CONFIGURATION_COMPRESSED EQU 0
CYDEV_CONFIGURATION_DMA EQU 1
CYDEV_CONFIGURATION_ECC EQU 1
CYDEV_CONFIGURATION_IMOENABLED EQU CYDEV_CONFIG_FASTBOOT_ENABLED
CYDEV_CONFIGURATION_MODE EQU CYDEV_CONFIGURATION_MODE_DMA
CYDEV_CONFIGURATION_MODE_COMPRESSED EQU 0
CYDEV_CONFIGURATION_MODE_UNCOMPRESSED EQU 1
CYDEV_CONFIG_UNUSED_IO EQU CYDEV_CONFIG_UNUSED_IO_AllowButWarn
CYDEV_CONFIG_UNUSED_IO_AllowWithInfo EQU 1
CYDEV_CONFIG_UNUSED_IO_Disallowed EQU 2
CYDEV_DEBUGGING_DPS EQU CYDEV_DEBUGGING_DPS_SWD_SWV
CYDEV_DEBUGGING_DPS_Disable EQU 3
CYDEV_DEBUGGING_DPS_JTAG_4 EQU 1
CYDEV_DEBUGGING_DPS_JTAG_5 EQU 0
CYDEV_DEBUGGING_DPS_SWD EQU 2
CYDEV_DEBUGGING_ENABLE EQU 1
CYDEV_DEBUGGING_XRES EQU 0
CYDEV_DEBUG_ENABLE_MASK EQU 0x01
CYDEV_DEBUG_ENABLE_REGISTER EQU CYREG_MLOGIC_DEBUG
CYDEV_DMA_CHANNELS_AVAILABLE EQU 24
CYDEV_ECC_ENABLE EQU 0
CYDEV_INSTRUCT_CACHE_ENABLED EQU 1
CYDEV_INTR_RISING EQU 0x00008000
CYDEV_PROJ_TYPE EQU 0
CYDEV_PROJ_TYPE_BOOTLOADER EQU 1
CYDEV_PROJ_TYPE_LOADABLE EQU 2
CYDEV_PROJ_TYPE_MULTIAPPBOOTLOADER EQU 3
CYDEV_PROJ_TYPE_STANDARD EQU 0
CYDEV_PROTECTION_ENABLE EQU 0
CYDEV_VARIABLE_VDDA EQU 0
CYDEV_VDDA LIT '5.0'
CYDEV_VDDA_MV EQU 5000
CYDEV_VDDD LIT '5.0'
CYDEV_VDDD_MV EQU 5000
CYDEV_VDDIO0 LIT '5.0'
CYDEV_VDDIO0_MV EQU 5000
CYDEV_VDDIO1 LIT '5.0'
CYDEV_VDDIO1_MV EQU 5000
CYDEV_VDDIO2 LIT '5.0'
CYDEV_VDDIO2_MV EQU 5000
CYDEV_VDDIO3 LIT '5.0'
CYDEV_VDDIO3_MV EQU 5000
CYDEV_VIO0 EQU 5
CYDEV_VIO0_MV EQU 5000
CYDEV_VIO1 EQU 5
CYDEV_VIO1_MV EQU 5000
CYDEV_VIO2 EQU 5
CYDEV_VIO2_MV EQU 5000
CYDEV_VIO3 EQU 5
CYDEV_VIO3_MV EQU 5000
DMA_CHANNELS_USED__MASK0 EQU 0x00000000
CYDEV_BOOTLOADER_ENABLE EQU 0

#endif /* INCLUDED_CYFITTERKEIL_INC */
